## config/board/shields/keeby/Kconfig.defconfig
```kconfig
if SHIELD_KEEBY_LEFT || SHIELD_KEEBY_RIGHT

config ZMK_KEYBOARD_NAME
    default "Keeby"

config ZMK_SPLIT
    default y

endif
```

## config/board/shields/keeby/Kconfig.shield
```kconfig
config SHIELD_KEEBY_LEFT
    def_bool $(shields_list_contains,keeby_left)

config SHIELD_KEEBY_RIGHT
    def_bool $(shields_list_contains,keeby_right)
```

## config/boards/shields/keeby/Kconfig.defconfig
```kconfig
if SHIELD_KEEBY_LEFT

config ZMK_KEYBOARD_NAME
    default "Keeby"

config ZMK_SPLIT_ROLE_CENTRAL
    default y

endif

if SHIELD_KEEBY_LEFT || SHIELD_KEEBY_RIGHT

config ZMK_SPLIT
    default y

if ZMK_DISPLAY

config I2C
    default y

config SSD1306
    default y

config ZMK_DISPLAY_BLANK_ON_IDLE
    default n 

config ZMK_WIDGET_BATTERY_STATUS
    default y

config ZMK_WIDGET_OUTPUT_STATUS
    default y

config ZMK_WIDGET_LAYER_STATUS
    default y

config ZMK_WIDGET_WPM_STATUS
    default y

endif # ZMK_DISPLAY

if LVGL

config LV_Z_VDB_SIZE
    default 64

config LV_DPI_DEF
    default 148

config LV_Z_BITS_PER_PIXEL
    default 1

choice LV_COLOR_DEPTH
    default LV_COLOR_DEPTH_1
endchoice

endif # LVGL

endif
```

#include "keeby.dtsi"

&default_transform {
    col-offset = <7>;
};

&right_encoder {
    status = "okay";
};

&kscan0 {
    col-gpios
            = <&gpio0 29 GPIO_ACTIVE_HIGH>
            , <&gpio1 4  GPIO_ACTIVE_HIGH>
            , <&gpio0 11 GPIO_ACTIVE_HIGH>
            , <&gpio0 24 GPIO_ACTIVE_HIGH>
            , <&gpio1 0  GPIO_ACTIVE_HIGH>
            , <&gpio0 31 GPIO_ACTIVE_HIGH>;
};